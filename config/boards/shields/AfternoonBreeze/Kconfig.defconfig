## config/boards/shields/AfternoonBreeze/Kconfig.defconfig
```kconfig
if SHIELD_AFTERNOON_BREEZE_LEFT

config ZMK_KEYBOARD_NAME
	default "Afternoon Breeze"

config ZMK_SPLIT_BLE_ROLE_CENTRAL
	default y

endif

if SHIELD_AFTERNOON_BREEZE_LEFT || SHIELD_AFTERNOON_BREEZE_RIGHT

config ZMK_SPLIT
	default y
	
config ZMK_SLEEP
	default y

config ZMK_IDLE_TIMEOUT
	default 180000

config ZMK_IDLE_SLEEP_TIMEOUT
	default 600000
 
endif
```

## config/boards/shields/AfternoonBreeze/Kconfig.shield
```kconfig
# Copyright (c) 2022 The ZMK Contributors
# SPDX-License-Identifier: MIT

config SHIELD_AFTERNOON_BREEZE_LEFT
    def_bool $(shields_list_contains,afternoon_breeze_left)

config SHIELD_AFTERNOON_BREEZE_RIGHT
    def_bool $(shields_list_contains,afternoon_breeze_right)
```
